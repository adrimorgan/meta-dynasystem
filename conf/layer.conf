## conf/layer.conf
```bitbake
BBPATH .= ":${LAYERDIR}"
BBFILES += "${LAYERDIR}/recipes-*/*/*.bb \
			${LAYERDIR}/recipes-*/*/*.bbappend"

BBFILE_COLLECTIONS += "dynasystem"
BBFILE_PATTERN_dynasystem = "^${LAYERDIR}/"
BBFILE_PRIORITY_dynasystem = "10"
```
